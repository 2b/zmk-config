## config/west.yml
```yaml
manifest:
  remotes:
    - name: zmkfirmware
      url-base: https://github.com/zmkfirmware
    - name: caksoylar
      url-base: https://github.com/2b
  projects:
    - name: zmk
      remote: caksoylar
      revision: caksoylar/zen+experimental
      import: app/west.yml
  self:
    path: config
```
